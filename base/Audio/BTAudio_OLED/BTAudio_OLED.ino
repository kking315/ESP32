#include <Arduino.h>
#include <Wire.h>
#include <Adafruit_GFX.h>
#include <Adafruit_SSD1306.h>
 
#include "BluetoothA2DPSink.h"
 
#define SCREEN_WIDTH 128 // OLED display width, in pixels
#define SCREEN_HEIGHT 64 // OLED display height, in pixels

// Declaration for an SSD1306 d isplay connected to I2C (SDA, SCL pins)
Adafruit_SSD1306 display(SCREEN_WIDTH, SCREEN_HEIGHT, &Wire, -1);
BluetoothA2DPSink a2dp_sink;
 
const unsigned char gImage_goodnight[1030] = { /*0X00,0X01,0X80,0X00,0X40,0X00,*/
0X00,0X00,0X00,0X00,0X00,0X00,0X00,0X00,0X00,0X00,0X00,0X00,0X00,0X00,0X00,0X00,
0X00,0X00,0X00,0X00,0X00,0X00,0X00,0X00,0X00,0X00,0X00,0X00,0X00,0X00,0X00,0X00,
0X00,0X00,0X00,0X00,0X00,0X00,0X00,0X00,0X00,0X00,0X00,0X00,0X00,0X00,0X00,0X00,
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0X00,0X00,0X00,0X00,0X00,0X00,0X00,0X00,0X00,0X00,0X00,0X00,0X00,0X00,0X00,0X00,
};

String str, s1, s2 = "";

void avrc_metadata_callback(uint8_t data1, const uint8_t *data2)
{
  Wire.begin(23,22);

  if(!display.begin(SSD1306_SWITCHCAPVCC, 0x3C,false,false)) { // Address 0x3D for 128x64
    Serial.println(F("SSD1306 allocation failed"));
    for(;;);
  }
  display.clearDisplay();
  delay(100);
  display.setTextSize(1);
  display.setTextColor(WHITE);
  display.setCursor(0, 6);

  // Serial.printf("AVRC metadata rsp: attribute id 0x%x, %s\n", data1, data2);
 
  //String strData2=getStringFromChars(data2,sizeof(data2));
  String strData2 = (const char *)data2;
  if (data1 == 2){  s1 = strData2;  Serial.printf("歌名：%s\n", data2);}
  if (data1 == 4){  s2 = strData2;  Serial.printf("专辑：%s\n", data2);}
  if (data1 == 1){  str = strData2;  Serial.printf("歌词：%s\n", data2);}

  if(s1.length()>25)
    display.println(s2);
  else
    display.println(s1);
  display.println();
  display.println(str);
  //display.drawBitmap(0, 0, gImage_goodnight, 128, 64, 1);
  display.display(); 
}

void setup(){
  Serial.begin(115200);

  i2s_pin_config_t my_pin_config = {
        .bck_io_num = 26,    //输入 BCLK
        .ws_io_num = 25,    //输入 LRC
        .data_out_num = 27, //输出 DIN
        .data_in_num = I2S_PIN_NO_CHANGE
  };

  a2dp_sink.set_avrc_metadata_attribute_mask(ESP_AVRC_MD_ATTR_TITLE | ESP_AVRC_MD_ATTR_ARTIST | ESP_AVRC_MD_ATTR_ALBUM | ESP_AVRC_MD_ATTR_TRACK_NUM | ESP_AVRC_MD_ATTR_NUM_TRACKS  );
  a2dp_sink.set_avrc_metadata_callback(avrc_metadata_callback);

  a2dp_sink.set_pin_config(my_pin_config);
  a2dp_sink.start("my music");
 
}
 
 
void loop(){
 
}